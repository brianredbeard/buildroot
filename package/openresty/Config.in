## package/openresty/Config.in
```kconfig
config BR2_PACKAGE_OPENRESTY
	bool "openresty"
	depends on !BR2_PACKAGE_NGINX
	help
	  OpenResty NGINX Variant

	  http://github.com/openresty/openresty
```

## package/perl-markdown-pod/Config.in
```kconfig
config BR2_PACKAGE_PERL_MARKDOWN_POD
	bool "perl-markdown-pod"
	help
	  This module parses Markdown text and return POD text.

	  https://metacpan.org/pod/Markdown::Pod
```
